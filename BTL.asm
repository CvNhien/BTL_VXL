		LCD_E	BIT P3.1
		LCD_RS 	BIT P3.0
		START	BIT	P3.3
		ALE		BIT	P3.2

		ORG	2000H	
		ACALL	CLEAR		//MOV	@R0, 30H
		ACALL	INIT_LCD	//MOV DPTR, #LCDADDR

		MOV	A,#80H
		ACALL	WRITECOM
		ACALL	DISPLAYSTRING1	//Xuat "KHOI LUONG: " 
		
		MOV	A,#0C0H
		ACALL	WRITECOM
		ACALL	DISPLAYSTRING2	//Xuat "GIA TIEN: "
	
MAIN:	ACALL	NHAP_ADC
		ACALL	XAC_DINH_GIA_TIEN
		ACALL	BCD
		ACALL	DISPLAY_KHOILUONG
		ACALL DELAY
		
		MOV	A,R4
		ACALL	BCD
		ACALL	DISPLAY_GIATIEN
		ACALL DELAY
		
		SJMP	MAIN
		
NHAP_ADC:	//nhap gia tri tu ADC ve
		CLR	START	
		CLR	ALE		//KHOI TAO
		SETB	START
		SETB	ALE
		CLR	START
		CLR	ALE
		//MOV DPTR, #ADC_ADDR
		//MOVX @DPTR,A 
		ACALL DELAY_120us
		//MOVX A,@DPTR
		MOV	A,P1
		RET
		
BCD:	// Chuyen gia tri trong A (nhan tu ADC) sang so BCD 
		PUSH	ACC
		MOV B, #100
		DIV AB 
		MOV R1,A 	// R1 hang tram
		MOV A,B
		MOV B, #10
		DIV AB 
		MOV R2, A	// R2 hang truc
		MOV R3, B	// R3 hang don vi
		POP ACC
		RET
		
DISPLAY_KHOILUONG:
		MOV A,#8CH
		ACALL WRITECOM
		MOV A,R1 
		ADD A,#30H
		ACALL WRITETEXT
				
		MOV A,#8DH
		ACALL WRITECOM
		MOV A,#'.'
		ACALL WRITETEXT
		
		MOV A,#8EH
		ACALL WRITECOM
		MOV A, R2
		ADD A, #30H
		ACALL WRITETEXT
		
		MOV A, #8FH
		ACALL WRITECOM
		MOV A,R3
		ADD A,#30H
		ACALL WRITETEXT
		RET
	
DISPLAY_GIATIEN:
		MOV A,#0CAH
		ACALL WRITECOM
		MOV A,R1
		ADD A,#30H
		ACALL WRITETEXT
		
		MOV A,#0CBH
		ACALL WRITECOM
		MOV A, R2
		ADD A, #30H
		ACALL WRITETEXT
		
		MOV A, #0CCH
		ACALL WRITECOM
		MOV A,#'.'
		ACALL WRITETEXT
		
		MOV A, #0CDH
		ACALL WRITECOM
		MOV A,R3
		ADD A,#30H
		ACALL WRITETEXT
		
		MOV A, #0CFH
		ACALL WRITECOM
		MOV A,#'$'
		ACALL WRITETEXT
		
		RET	
CLEAR:
		MOV A, #01H
		ACALL WRITECOM
		RET
		
INIT_LCD:
		MOV A,#38H
		ACALL WRITECOM
		MOV A,#0EH
		ACALL WRITECOM
		MOV A,#06H
		LCALL WRITECOM
		RET		
		
WRITETEXT:	//MOV DPTR,#LCDADDR
		SETB LCD_E
		SETB LCD_RS
		MOV	P0,A	//MOVX @DPTR, A
		CLR	LCD_E
		ACALL	WAIT_LCD
		RET	
		
WRITECOM:	//MOV DPTR, #LCDADDR
		SETB LCD_E
		CLR	LCD_RS
		MOV	P0,A	//MOVX @DPTR, A	
		CLR	LCD_E
		ACALL WAIT_LCD
		RET
		
DISPLAYSTRING1:
		MOV A,#0	
	LOOP:
		MOV DPTR,#MESSAGE1
		MOV	R0,A
		MOVC	A,@A+DPTR
		JZ	EXIT
		ACALL	WRITETEXT	
		MOV	A,R0
		INC	A
		DJNZ	B,LOOP	
	EXIT:
		RET	
	
DISPLAYSTRING2:
		MOV A,#0
	LOOP1:
		MOV DPTR,#MESSAGE2    
		MOV	R0,A
		MOVC	A,@A+DPTR
		JZ	EXIT1
		ACALL	WRITETEXT
		MOV	A,R0
		INC	A
		DJNZ	B,LOOP1
	EXIT1:
		RET
		
DELAY:
		MOV R6, #200
L1:		MOV R7, #250
		DJNZ R7,$
		DJNZ	R6,L1
		RET
		
WAIT_LCD: 
		MOV R6,#10
DL1:	MOV R7,#250
		DJNZ R7,$
		DJNZ R6, DL1
		RET
		
DELAY_120us:
		MOV R7,#60
		DJNZ R7,$
		RET		
		
XAC_DINH_GIA_TIEN:	// luu gia tien vao R4
		JNZ	MUC0
		MOV	R4,#0
		RET
MUC0:	CJNE	A,#100,$+3		//Duoi 1 Kg
		JNC	MUC1
		MOV	R4,#100
		RET
MUC1:	CJNE	A,#120,$+3		// Tu 1 Den duoi 2 Kg
		JNC	MUC2
		MOV	R4,#120
		RET
MUC2:	CJNE	A,#150,$+3				// Tu 1,2 den duoi 1.5 Kg
		JNC	MUC3
		MOV	R4,#145
		RET
MUC3:	CJNE	A,#180,$+3		//Tu 1,5 den duoi 1,8 Kg
		JNC	MUC4
		MOV	R4,#200
		RET
MUC4:	CJNE	A,#220,$+3				// Tu 1,8 den duoi 2,2 Kg
		JNC	MUC5
		MOV	R4,#180
		RET
MUC5:	MOV	R4,#165					// Tu 2,2 Kg
		RET
		
MESSAGE1:
		DB	"KHOI LUONG: ",0		
MESSAGE2:
		DB	"GIA TIEN: ",0
			
END
